## esp32/pwm/main/Kconfig.projbuild
```kconfig
menu "Example Configuration"

    config BLINK_GPIO
        int "Blink GPIO number"
        range 0 34
        default 2
        help
            GPIO number (IOxx) to blink on and off.

            Some GPIOs are used for other purposes (flash connections, etc.) and cannot be used to blink.

            GPIOs 35-39 are input-only so cannot be used as outputs.
    config PWM_FREQ
        int "pwm freq"
        range 1 10000
        default 1000
        help
            config pwm freq range from 1Hz to 10KHz

endmenu
```

## esp32/task_create/main/Kconfig.projbuild
```kconfig
menu "Example Configuration"

    config TASK_CREATE
        bool "task_create"
endmenu
```

## esp32/timer/main/Kconfig.projbuild
```kconfig
menu "Example Configuration"

    config usr_timer
        bool "usr_timer"
        default y
        help
            config default timer
    config BLINK_GPIO
        int "Blink GPIO number"
        range 0 34
        default 2
        help
            GPIO number (IOxx) to blink on and off.

            Some GPIOs are used for other purposes (flash connections, etc.) and cannot be used to blink.

            GPIOs 35-39 are input-only so cannot be used as outputs.
endmenu
```
